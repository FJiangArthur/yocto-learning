## labs/lab-03-meta-layer/solution/meta-lab-complete/conf/layer.conf
```bitbake
# Layer configuration for meta-lab - Complete Solution
BBPATH .= ":${LAYERDIR}"

BBFILES += "${LAYERDIR}/recipes-*/*/*.bb \
            ${LAYERDIR}/recipes-*/*/*.bbappend"

BBFILE_COLLECTIONS += "meta-lab"
BBFILE_PATTERN_meta-lab = "^${LAYERDIR}/"
BBFILE_PRIORITY_meta-lab = "8"

LAYERSERIES_COMPAT_meta-lab = "kirkstone"
LAYERDEPENDS_meta-lab = "core"
LAYERVERSION_meta-lab = "1"
```

## meta-layers/meta-interview-study/conf/layer.conf
```bitbake
# meta-interview-study/conf/layer.conf - Layer configuration file
#
# This file defines the meta-interview-study layer configuration for Yocto/OpenEmbedded.
# It specifies layer metadata, dependencies, priorities, and version compatibility.
#
# Learning objectives:
# 1. Understand layer.conf structure and required variables
# 2. Learn layer dependency management (LAYERDEPENDS)
# 3. Practice version compatibility specification
# 4. Handle layer priorities for recipe override control

# We have a conf and classes directory, add to BBPATH
BBPATH .= ":${LAYERDIR}"

# We have recipes-* directories, add to BBFILES
# This makes BitBake aware of all .bb and .bbappend files in this layer
BBFILES += "${LAYERDIR}/recipes-*/*/*.bb \
            ${LAYERDIR}/recipes-*/*/*.bbappend"

# Layer collection name - must be unique across all layers
# Used in LAYERDEPENDS and LAYERSERIES_COMPAT
BBFILE_COLLECTIONS += "meta-interview-study"

# Pattern to match files from this layer in BBFILES
# Helps BitBake identify which files belong to this layer
BBFILE_PATTERN_meta-interview-study = "^${LAYERDIR}/"

# Priority of recipes in this layer (default is 5)
# Higher priority = higher precedence when multiple layers provide same recipe
# Priority range: 1-10 (1=lowest, 10=highest)
# Use 6-7 for application layers, 8-9 for BSP layers
BBFILE_PRIORITY_meta-interview-study = "7"

# Layer name and version
LAYERVERSION_meta-interview-study = "1"

# Layer dependencies - other layers required by this layer
# Format: "layer-name:optional-version"
LAYERDEPENDS_meta-interview-study = " \
    core \
    openembedded-layer \
"

# Conditional dependency on meta-tegra (for Jetson support)
# Only required when building for Jetson platforms
LAYERDEPENDS_meta-interview-study += " \
    ${@'meta-tegra' if d.getVar('MACHINE').startswith('jetson') or 'tegra' in d.getVar('SOC_FAMILY', True) or '' else ''} \
"

# Layer series compatibility
# Specifies which Yocto releases this layer is compatible with
# Update this list as you test with newer Yocto releases
LAYERSERIES_COMPAT_meta-interview-study = "kirkstone langdale mickledore nanbield scarthgap"

# Recipe name mapping (for renamed recipes)
# BBFILE_PATTERN_IGNORE_EMPTY_meta-interview-study = "1"

# Documentation directory
DOC_DIR = "${LAYERDIR}/doc"

# Example directory for reference applications
EXAMPLES_DIR = "${LAYERDIR}/examples"

# Layer-specific variables

# Default CUDA architecture for this layer's recipes
# Override in local.conf or machine config if different
CUDA_ARCH ??= "sm_87"  # Jetson Orin default

# Default TensorRT version
TENSORRT_VERSION ??= "8.6"

# Enable custom package group by default
INTERVIEW_STUDY_PACKAGEGROUP ??= "packagegroup-interview-study"

# Path to layer's machine configurations
BBFILES += "${LAYERDIR}/conf/machine/*.conf"

# Class files directory
# Classes in this directory are automatically available to all recipes
BBFILES += "${LAYERDIR}/classes/*.bbclass"

# Layer sanity check
# Validates that required variables are set
# SANITY_REQUIRED_UTILITIES:append = " cuda-capable-gpu"

# Dynamic layer support
# Enable/disable parts of layer based on available layers
# Checked in recipes using ${@bb.utils.contains_any('BBFILE_COLLECTIONS', 'meta-tegra', ...)}

# License files directory
# Provides license templates for recipes in this layer
LICENSE_PATH += "${LAYERDIR}/licenses"

# Layer README and documentation
LAYER_README = "${LAYERDIR}/README.md"

# Preferred providers for virtual packages
# Example: prefer our custom kernel over others
# PREFERRED_PROVIDER_virtual/kernel:jetson-orin = "linux-tegra"

# Preferred versions (if needed)
# PREFERRED_VERSION_cuda-toolkit = "11.8%"
# PREFERRED_VERSION_tensorrt = "8.6%"

# Machine override order (if needed)
# Ensures machine-specific settings take precedence
# MACHINEOVERRIDES:prepend:jetson-orin = "tegra234:"

# Add layer-specific sstate mirror (if available)
# SSTATE_MIRRORS:append = " file://.* http://example.com/sstate-cache/PATH \n "

# Layer maintenance information
LAYER_MAINTAINER = "Interview Study Team <team@example.com>"
LAYER_HOMEPAGE = "https://github.com/example/meta-interview-study"

# BitBake environment setup hook (optional)
# Runs when layer is initialized
# LAYERDIR_RE = "${LAYERDIR}"

# Advanced: Dynamic layer configuration
# python __anonymous() {
#     # Python code to run during recipe parsing
#     # Can modify variables dynamically based on build configuration
#     machine = d.getVar('MACHINE')
#     if machine and machine.startswith('jetson'):
#         d.appendVar('PREFERRED_PROVIDER_virtual/kernel', 'linux-tegra')
# }

# Recipe-specific default variables
# These can be overridden in local.conf or machine configs

# GPIO tool defaults
GPIO_TOOL_DEFAULT_CHIP ??= "gpiochip0"

# TensorRT optimization defaults
TENSORRT_ENABLE_FP16 ??= "1"
TENSORRT_ENABLE_INT8 ??= "0"
TENSORRT_MAX_WORKSPACE ??= "1073741824"  # 1GB

# CUDA compilation defaults
CUDA_ENABLE_FAST_MATH ??= "1"
CUDA_VERBOSE_COMPILE ??= "1"

# systemd service defaults
SYSTEMD_AUTO_ENABLE_DEFAULT ??= "enable"

# Image configuration defaults
IMAGE_ROOTFS_SIZE_DEFAULT ??= "16777216"  # 16GB
IMAGE_ROOTFS_EXTRA_SPACE_DEFAULT ??= "1048576"  # 1GB

# Development mode flag
# Set to "1" for development builds, "0" for production
INTERVIEW_STUDY_DEV_MODE ??= "1"

# Conditional package installation based on dev mode
# CORE_IMAGE_EXTRA_INSTALL:append = "${@'gdb valgrind' if d.getVar('INTERVIEW_STUDY_DEV_MODE') == '1' else ''}"

# Testing configuration
# Enable test suites if in development mode
# INHERIT:append = "${@' testimage' if d.getVar('INTERVIEW_STUDY_DEV_MODE') == '1' else ''}"

# Layer signature for reproducible builds
# BB_SIGNATURE_EXCLUDE_FLAGS:append = " INTERVIEW_STUDY_DEV_MODE"

# Add custom configuration files directory to file search path
FILESEXTRAPATHS:prepend := "${LAYERDIR}/files:"

# Additional BBPATH directories for includes and configuration
BBPATH:prepend = "${LAYERDIR}:"

# Layer-specific distro features
# These can be appended to DISTRO_FEATURES in distro config
LAYER_DISTRO_FEATURES = "systemd cuda tensorrt gpio-control"

# Machine features provided by this layer
LAYER_MACHINE_FEATURES = "cuda tensorrt nvme pcie wifi bluetooth"

# Example of conditional recipe inclusion:
# Include CUDA recipes only if machine has GPU support
# BBMASK:append = "${@'' if bb.utils.contains('MACHINE_FEATURES', 'gpu', True, False, d) else '|meta-interview-study/recipes-cuda/'}"

# Layer usage example in bblayers.conf:
#
# BBLAYERS ?= " \
#   /path/to/poky/meta \
#   /path/to/poky/meta-poky \
#   /path/to/meta-openembedded/meta-oe \
#   /path/to/meta-tegra \
#   /path/to/meta-interview-study \
# "

# Common layer.conf debugging:
# bitbake-layers show-layers                    # Show all layers and priorities
# bitbake-layers show-recipes                   # Show recipes from all layers
# bitbake-layers show-appends                   # Show all .bbappend files
# bitbake-layers show-overlayed                 # Show overlayed recipes
# bitbake-layers layerindex-fetch meta-*        # Fetch layer from index
# bitbake-layers add-layer /path/to/layer       # Add layer to build
```

## meta-layers/meta-interview-study/conf/machine/interview-jetson-orin.conf
```bitbake
# interview-jetson-orin.conf - Machine configuration for Jetson Orin AGX
#
# This file defines a custom machine configuration for NVIDIA Jetson Orin AGX.
# Machine configs specify hardware-specific settings: architecture, kernel,
# bootloader, GPU support, and hardware features.
#
# Learning objectives:
# 1. Understand machine configuration structure
# 2. Learn hardware capability declaration (MACHINE_FEATURES)
# 3. Practice BSP integration and customization
# 4. Handle SOC-specific compiler and kernel settings

#@TYPE: Machine
#@NAME: Interview Study Jetson Orin AGX
#@DESCRIPTION: Custom machine configuration for NVIDIA Jetson Orin AGX development platform
#@MAINTAINER: Interview Study Team <team@example.com>

# Include base Jetson Orin configuration from meta-tegra
# This provides fundamental Tegra234 support
require conf/machine/jetson-orin-agx-devkit.conf

# Alternative: Define from scratch (more control, more work)
# In that case, uncomment and configure all sections below

# SOC family identification
# Used for conditional recipe inclusion and features
SOC_FAMILY = "tegra234"

# Machine architecture
# Jetson Orin uses ARM64 (aarch64)
DEFAULTTUNE = "armv8a-crc-crypto"

# Include ARM tuning for ARMv8
require conf/machine/include/arm/armv8a/tune-cortexa78.inc

# Kernel configuration
PREFERRED_PROVIDER_virtual/kernel = "linux-tegra"
PREFERRED_VERSION_linux-tegra = "5.10%"

# Kernel image type
KERNEL_IMAGETYPE = "Image"
KERNEL_IMAGETYPES = "Image Image.gz"

# Kernel device tree
# Jetson Orin DTB files
KERNEL_DEVICETREE = " \
    nvidia/tegra234-p3701-0000-p3737-0000.dtb \
    nvidia/tegra234-p3701-0000-p3737-0000-overlay.dtbo \
"

# Custom device tree overlays
KERNEL_DEVICETREE:append = " \
    nvidia/interview-study-gpio.dtbo \
    nvidia/interview-study-i2c.dtbo \
    nvidia/interview-study-spi.dtbo \
"

# Bootloader configuration
PREFERRED_PROVIDER_virtual/bootloader = "cboot-t234"
UBOOT_MACHINE = "p3701-0000_defconfig"

# Machine features
# Declares hardware capabilities available on this platform
MACHINE_FEATURES = " \
    alsa \
    bluetooth \
    ext2 \
    pci \
    pcie \
    screen \
    usbgadget \
    usbhost \
    vfat \
    wifi \
    cuda \
    nvme \
"

# Serial console configuration
SERIAL_CONSOLES = "115200;ttyTCU0"

# Extra kernel command-line arguments
KERNEL_ARGS = "console=ttyTCU0,115200 rootwait rootfstype=ext4"

# Root filesystem type
# Options: ext4, ext3, ext2, btrfs
IMAGE_FSTYPES = "ext4 tar.gz wic.bmap wic.gz"

# WIC (disk image) configuration
WKS_FILE = "jetson-orin-agx.wks"
WKS_FILE_DEPENDS = "tegra-binaries"

# GPU configuration
# CUDA compute capability for Orin (Ampere architecture)
CUDA_ARCHITECTURES = "87"
CUDA_NVCC_ARCH_FLAGS = "-gencode arch=compute_87,code=sm_87"

# CUDA and GPU packages
MACHINE_ESSENTIAL_EXTRA_RDEPENDS = " \
    kernel-image \
    kernel-devicetree \
    kernel-modules \
    tegra-firmware \
    tegra-nvpmodel \
    tegra-configs \
"

# CUDA toolkit version
PREFERRED_VERSION_cuda-toolkit = "11.8%"
PREFERRED_VERSION_cudnn = "8.6%"
PREFERRED_VERSION_tensorrt = "8.6%"

# Graphics and multimedia
PREFERRED_PROVIDER_virtual/egl = "libglvnd"
PREFERRED_PROVIDER_virtual/libgles1 = "libglvnd"
PREFERRED_PROVIDER_virtual/libgles2 = "libglvnd"
PREFERRED_PROVIDER_virtual/libgl = "libglvnd"

# GStreamer plugins for hardware acceleration
MACHINE_GSTREAMER_PLUGINS = " \
    gstreamer1.0-plugins-nvvideoconvert \
    gstreamer1.0-plugins-nvarguscamerasrc \
    gstreamer1.0-plugins-nvv4l2camerasrc \
    gstreamer1.0-plugins-nvjpegenc \
    gstreamer1.0-plugins-nvjpegdec \
"

# DLA (Deep Learning Accelerator) support
# Orin has 2 DLA cores
DLA_CORES = "2"
TENSORRT_ENABLE_DLA = "1"

# Camera support (CSI cameras via Argus)
MACHINE_EXTRA_RDEPENDS:append = " \
    libargus \
    tegra-libraries-argus \
    tegra-libraries-camera \
"

# Networking configuration
# PCIe-based WiFi/Bluetooth module
MACHINE_EXTRA_RRECOMMENDS = " \
    linux-firmware-bcm4354 \
    linux-firmware-bcmdhd \
"

# Storage
# Orin supports NVMe SSDs via PCIe
MACHINE_FEATURES:append = " nvme"

# Extra packages specific to this machine
MACHINE_EXTRA_RDEPENDS:append = " \
    tegra-tools \
    jetson-gpio \
    gpio-tool \
"

# Power management
# nvpmodel profiles for different power modes
NVPMODEL_CONFIG_DEFAULT = "MODE_15W"

# CPU governor
# Options: performance, powersave, ondemand, conservative, schedutil
CPU_GOVERNOR = "schedutil"

# Package architecture
# Machine-specific packages (not compatible with other machines)
PACKAGE_ARCH = "${MACHINE_ARCH}"

# Toolchain configuration
# Compiler flags for Cortex-A78 (Orin CPU cores)
TUNE_CCARGS:append = " -mcpu=cortex-a78 -mtune=cortex-a78"

# Optimization flags
TARGET_CFLAGS:append = " -O3 -ffast-math"
TARGET_CXXFLAGS:append = " -O3 -ffast-math"

# Linker flags
TARGET_LDFLAGS:append = " -Wl,--as-needed"

# Image overhead factor
# Multiplier for root filesystem size calculation
IMAGE_OVERHEAD_FACTOR = "1.3"

# Extra image space (in KB)
IMAGE_ROOTFS_EXTRA_SPACE = "1048576"  # 1GB

# Wic configuration for bootable SD card/eMMC/NVMe image
# Example WKS file content (jetson-orin-agx.wks):
#
# part /boot --source bootimg-partition --ondisk mmcblk0 --fstype=vfat --label boot --active --align 4096 --size 256M
# part / --source rootfs --ondisk mmcblk0 --fstype=ext4 --label root --align 4096 --size 16G
# part /data --ondisk mmcblk0 --fstype=ext4 --label data --align 4096 --size 32G

# Systemd configuration
INIT_MANAGER = "systemd"
DISTRO_FEATURES:append = " systemd"
DISTRO_FEATURES_BACKFILL_CONSIDERED:append = " sysvinit"

# Security features
DISTRO_FEATURES:append = " pam"

# Development features
# Remove in production builds
EXTRA_IMAGE_FEATURES:append = " debug-tweaks tools-debug tools-profile"

# SDK configuration
# Cross-compilation SDK for this machine
SDKMACHINE = "x86_64"

# Preferred providers for SDK
PREFERRED_PROVIDER_nativesdk-cuda-toolkit = "nativesdk-cuda-toolkit"

# Flash tool configuration
# Used for flashing Jetson devices
TNSPEC_MACHINE = "3701-0000-as-3737-0000"

# Tegra binaries version
PREFERRED_VERSION_tegra-binaries = "35.5.0"

# U-Boot configuration (if using U-Boot instead of cboot)
# PREFERRED_PROVIDER_virtual/bootloader = "u-boot-tegra"
# UBOOT_MACHINE = "p3701-0000_defconfig"
# UBOOT_EXTLINUX = "1"
# UBOOT_EXTLINUX_ROOT = "root=/dev/mmcblk0p1"

# Custom machine-specific tasks
# Example: Generate hardware documentation
# do_generate_hw_docs[depends] += "virtual/kernel:do_shared_workdir"
# do_generate_hw_docs() {
#     # Generate pinmux documentation
#     # Generate GPIO mapping tables
#     # etc.
# }

# Machine testing configuration
# TEST_TARGET = "simpleremote"
# TEST_TARGET_IP = "192.168.1.100"
# TEST_SERVER_IP = "192.168.1.1"

# Compatible layers check
# INHERIT += "sanity"
# SANITY_REQUIRED_UTILITIES:append = " nvidia-smi"

# Machine-specific distro features
# MACHINE_DISTRO_FEATURES = "cuda tensorrt dla nvme"

# Example of conditional configuration based on image type:
# IMAGE_BOOT_FILES:interview-study-image = " \
#     Image \
#     tegra234-p3701-0000-p3737-0000.dtb \
# "

# Custom machine tasks for Jetson
# Example: Flash target after build
# addtask flash_target after do_image_complete
# do_flash_target() {
#     echo "Flashing Jetson Orin..."
#     # sudo ./flash.sh jetson-orin-agx-devkit mmcblk0p1
# }

# Usage:
# Set MACHINE = "interview-jetson-orin" in local.conf
# Then build: bitbake custom-image

# Machine debugging:
# bitbake -e | grep ^MACHINE=                   # Verify machine name
# bitbake -e | grep ^MACHINE_FEATURES=          # Check machine features
# bitbake -e | grep ^DEFAULTTUNE=               # Check architecture tuning
# bitbake -e | grep ^PREFERRED_PROVIDER_virtual/kernel=  # Check kernel provider
# bitbake virtual/kernel -c menuconfig          # Configure kernel
# bitbake -c deploy_data custom-image           # Deploy image artifacts
```
